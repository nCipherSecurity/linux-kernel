## drivers/hsm/Kconfig
```kconfig
menuconfig HSM
   bool "Support for Hardware Security Modules"
   ---help---
     A Hardware Securxoity Module (HSM) is a device which provides
     a secure environment in which to perform encryption and key
     management.

     Choose and use this menu if you expect to use one or more
     Hardware Security Modules.

source "drivers/hsm/ncipher/nshield_solo/Kconfig"
#endmenu
```

## drivers/hsm/ncipher/nshield_solo/Kconfig
```kconfig
config HSM_NCIPHER_SOLO
   tristate "nCipher Solo and SoloXC family of PCIe HSMs"
   depends on PCI && HSM
   default m if PCI && HSM && MODULES
   default y if PCI && HSM
   ---help---
     Select this as built-in or module if you expect
     to use an HSM from nCipher's Solo or SoloXC range.
```

## drivers/staging/ncipher/Kconfig
```kconfig
menuconfig NCIPHER
   bool "Support for nCipher Solo / SoloXC HSMs"
   help
     Choose this if you expect to use nCipher Solo or SoloXC
     Hardware Security Modules (HSM).
source "drivers/staging/ncipher/nshield_solo/Kconfig"
#endmenu
```

## drivers/staging/ncipher/nshield_solo/Kconfig
```kconfig
# Enable support for nCipher's nShield Solo and Solo XC
# HSMs
config HSM_NCIPHER_NSHIELD_SOLO
   tristate "nCipher Solo and Solo XC family of PCIe HSMs"
   depends on PCI && NCIPHER
   help
     Select this as built-in or module if you expect
     to use a Hardware Security Module from nCipher's Solo or Solo XC range.
```
